## conf/layer.conf
```bitbake
# We have a conf and classes directory, append to BBPATH
BBPATH .= ":${LAYERDIR}"

# We have a recipes directory, add to BBFILES
BBFILES += "${LAYERDIR}/recipes-*/*/*.bb ${LAYERDIR}/recipes-*/*/*.bbappend"

BBFILE_COLLECTIONS += "ros-webos-layer"
BBFILE_PATTERN_ros-webos-layer := "^${LAYERDIR}/"
BBFILE_PRIORITY_ros-webos-layer = "52"

# Version 1 was the manually created meta-ros, prior to the introduction of superflore.
# Version 2 was all ROS distributions in the same meta-ros layer with right subdirectories selected by ROS_DISTRO variable
# Version 3 is with each ROS distribution in separate sublayer of meta-ros git repository (with modifications to generated recipes applied in .bbappends instead of .inc files)
LAYERVERSION_ros-webos-layer = "3"

LAYERDEPENDS_ros-webos-layer = " \
    core \
    meta-python \
    openembedded-layer \
    ros-common-layer \
"

LAYERSERIES_COMPAT_ros-webos-layer = "thud"

# Don't allow ROS-only images to be built with DISTRO set to "webos" as they will contain different platform packages, eg, the
# kernel, from images with the same names built with DISTRO set to "ros1" or "ros2". Using BBMASK instead of PNBLACKLIST because
# a RE name match is wanted.
BBMASK += "recipes-core/images/ros-image-.*"

require conf/ros-distro/include/webos-compat.inc
```
